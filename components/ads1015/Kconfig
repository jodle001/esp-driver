## components/ads1015/Kconfig
```kconfig
menu "ADS1015 Configuration"

    config ADS1015_HIGH_THRESH
        int "ADS1015 HIGH THRESH"
        default 100
        help
            High threshold for ADS1015 current sensing.

    config ADS1015_LOW_THRESH
        int "ADS1015 LOW THRESH"
        default -100
        help
            Low threshold for ADS1015 current sensing.

    config ADS1015_TRIP_SAMPLES
        int "Samples in a row past a threshold to stop the motors"
        range 1 100
        default 3
        help
            One input must read past the high or low threshold this many
            times in a row before the motors stop, so a single noisy sample
            does not stop them. The two inputs take turns: at 3300 SPS
            (ADS1015) each is read about every 0.6 ms, at 475 SPS (ADS1115)
            about every 4 ms.

endmenu
```

## main/Kconfig.projbuild
```kconfig
menu "Talos ESP Driver Configuration"
    config DRIVER_MOTORHAT_SDA_PIN
        int "MotorHAT SDA Pin"
        default 21
        help
            GPIO pin number for MotorHAT SDA line.

    config DRIVER_MOTORHAT_SCL_PIN
        int "MotorHAT SCL Pin"
        default 22
        help
            GPIO pin number for MotorHAT SCL line.

    config DRIVER_MOTORHAT_I2C_BUS
        int "MotorHAT I2C Bus Number"
        default 1
        help
            I2C bus number for MotorHAT communication.

    config DRIVER_MOTORHAT_ADDRESS
        hex "MotorHAT I2C Address"
        default 0x60
        help
            I2C address for the MotorHAT device.

    config DRIVER_MOTORHAT_PAN_SPEED
        string "MotorHAT homing speed"
        default "0.25"
        help
            The fraction of PCA9685's max PWM speed used by homing. Polar pan
            uses the per-axis speeds in the Axes menu.

    config DRIVER_ADS1015_ADDRESS
        hex "ADS1015 I2C Address"
        default 0x4a
        help
            I2C address for the ADS1015 device.

    config DRIVER_ADS1015_RDY_PIN
        int "ADS1015 RDY Pin"
        default 18
        help
            GPIO pin number for the ADS1015 RDY line.

    config DRIVER_ADS1015_DATA_RATE
        int "ADS1015 Data Rate"
        range 0 6
        default 6
        help
            Data rate of ADS1015 in samples per second.
            0=128SPS, 1=250SPS, 2=490SPS, 3=920SPS,
            4=1600SPS, 5=2400SPS, 6=3300SPS

    config DRIVER_LIMIT_SWITCH_PIN
        int "Limit Switch Pin"
        default 23
        help
            GPIO pin for limit switch alerts.

    config DRIVER_WIFI_SSID
        string "WiFi SSID"
        default "YourSSID"
        help
            SSID of the WiFi network to connect to.

    config DRIVER_WIFI_PASSWORD
        string "WiFi Password"
        default "YourPassword"
        help
            Password for the WiFi network.

    config DRIVER_SERVER_IP
        string "Server IP Address"
        default "0.0.0.0"
        help
            Listening IP address for the server.

    config DRIVER_SERVER_PORT
        string "Server Port"
        default "8080"
        help
            Listening port for the server.

    config DRIVER_MAX_RUN_MS
        int "Longest a pan may run without a new start command (ms)"
        range 0 60000
        default 3000
        help
            An axis driven longer than this since the last polar pan start
            command is stopped. Commander's auto tracking repeats the start
            command every 100 ms; a manual key press sends it once. 0 turns
            the check off.

endmenu

menu "Axes"
    config DRIVER_AZIMUTH_MOTOR
        int "Motor HAT port driving azimuth (base), 1-4 = M1-M4"
        range 1 4
        default 3

    config DRIVER_AZIMUTH_ENCODER_A_PIN
        int "Azimuth encoder channel A (P0) GPIO"
        range 0 39
        default 36

    config DRIVER_AZIMUTH_ENCODER_B_PIN
        int "Azimuth encoder channel B (P1) GPIO"
        range 0 39
        default 39

    config DRIVER_ALTITUDE_MOTOR
        int "Motor HAT port driving altitude, 1-4 = M1-M4"
        range 1 4
        default 4

    config DRIVER_ALTITUDE_ENCODER_A_PIN
        int "Altitude encoder channel A (P0) GPIO"
        range 0 39
        default 34

    config DRIVER_ALTITUDE_ENCODER_B_PIN
        int "Altitude encoder channel B (P1) GPIO"
        range 0 39
        default 35

    config DRIVER_AZIMUTH_PAN_SPEED
        string "Azimuth pan speed (fraction of full PWM, 0 to 1)"
        default "0.25"
        help
            Keep a stalled motor inside the TB6612's 1.0 A rating: speed no
            higher than 1.0 A times the motor's winding resistance divided by
            the 12 V supply. 0.25 is safe from about 3 ohms up.

    config DRIVER_ALTITUDE_PAN_SPEED
        string "Altitude pan speed (fraction of full PWM, 0 to 1)"
        default "0.25"
        help
            Used for both wrist motors when the second altitude motor is
            enabled. Same stall rule as the azimuth speed.

    config DRIVER_ALTITUDE_B_ENABLE
        bool "Drive altitude with a second motor (ER-4pc wrist pitch)"
        default n
        help
            The ER-4pc wrist is a bevel gear differential: the wrist pitches
            only when motors 4 and 5 turn in opposite directions, and one
            motor alone rolls it. When enabled, altitude commands drive both
            wrist motors, and if either one stops the other stops too.

    config DRIVER_ALTITUDE_B_MOTOR
        int "Motor HAT port driving the second altitude motor, 1-4 = M1-M4"
        depends on DRIVER_ALTITUDE_B_ENABLE
        range 1 4
        default 2

    config DRIVER_ALTITUDE_B_REVERSED
        bool "Drive the second altitude motor opposite to the first"
        depends on DRIVER_ALTITUDE_B_ENABLE
        default y
        help
            Pitch on the ER-4pc wrist needs the two motors turning in
            opposite directions. If a tilt command rolls the wrist on the
            bench instead, the motors are wired the other way around: change
            this.

    config DRIVER_ALTITUDE_B_ENCODER_A_PIN
        int "Second altitude motor encoder channel A (P0) GPIO"
        depends on DRIVER_ALTITUDE_B_ENABLE
        range 0 39
        default 27

    config DRIVER_ALTITUDE_B_ENCODER_B_PIN
        int "Second altitude motor encoder channel B (P1) GPIO"
        depends on DRIVER_ALTITUDE_B_ENABLE
        range 0 39
        default 14

endmenu

menu "Soft Limits"
    config DRIVER_SOFT_LIMITS_ENABLE
        bool "Enable encoder soft limits"
        default y
        help
            Stops an axis once its encoder count passes a bound computed from
            the values below. Boot position is treated as home (count 0).
            While enabled, the home command is rejected.

    config DRIVER_SOFT_LIMITS_PERCENT
        int "Percent of physical travel allowed on each side of home"
        range 1 100
        default 50

    config DRIVER_SOFT_LIMITS_POLL_MS
        int "Soft limit check interval (ms)"
        range 1 100
        default 10

    menu "Azimuth axis"
        config DRIVER_SOFT_LIMITS_AZIMUTH_ENCODER_SLOTS
            int "Encoder wheel slots"
            range 1 1000
            default 20
        config DRIVER_SOFT_LIMITS_AZIMUTH_GEARBOX_RATIO
            string "Motor gearbox ratio (X:1)"
            default "127.1"
        config DRIVER_SOFT_LIMITS_AZIMUTH_PINION_TEETH
            int "Transmission pinion (motor side) teeth"
            range 1 1000
            default 24
        config DRIVER_SOFT_LIMITS_AZIMUTH_DRIVEN_TEETH
            int "Transmission driven (joint side) teeth"
            range 1 1000
            default 120
        config DRIVER_SOFT_LIMITS_AZIMUTH_RANGE_POS_DEG
            int "Physical travel from home, positive-count direction (deg)"
            range 0 360
            default 133
        config DRIVER_SOFT_LIMITS_AZIMUTH_RANGE_NEG_DEG
            int "Physical travel from home, negative-count direction (deg)"
            range 0 360
            default 133
        config DRIVER_SOFT_LIMITS_AZIMUTH_FWD_INCREASES
            int "FORWARD increases encoder count (1) or decreases it (0)"
            range 0 1
            default 1
            help
                PLACEHOLDER until bench tested. Set to 1 if driving this
                axis's motor FORWARD makes its encoder count go up, 0 if it
                makes the count go down.
    endmenu

    menu "Altitude axis"
        config DRIVER_SOFT_LIMITS_ALTITUDE_ENCODER_SLOTS
            int "Encoder wheel slots"
            range 1 1000
            default 20
        config DRIVER_SOFT_LIMITS_ALTITUDE_GEARBOX_RATIO
            string "Motor gearbox ratio (X:1)"
            default "65.5"
        config DRIVER_SOFT_LIMITS_ALTITUDE_PINION_TEETH
            int "Transmission pinion (motor side) teeth"
            range 1 1000
            default 12
        config DRIVER_SOFT_LIMITS_ALTITUDE_DRIVEN_TEETH
            int "Transmission driven (joint side) teeth"
            range 1 1000
            default 23
        config DRIVER_SOFT_LIMITS_ALTITUDE_RANGE_POS_DEG
            int "Physical travel from home, positive-count direction (deg)"
            range 0 360
            default 45
        config DRIVER_SOFT_LIMITS_ALTITUDE_RANGE_NEG_DEG
            int "Physical travel from home, negative-count direction (deg)"
            range 0 360
            default 45
        config DRIVER_SOFT_LIMITS_ALTITUDE_FWD_INCREASES
            int "FORWARD increases encoder count (1) or decreases it (0)"
            range 0 1
            default 1
            help
                PLACEHOLDER until bench tested. Set to 1 if driving this
                axis's motor FORWARD makes its encoder count go up, 0 if it
                makes the count go down.

        config DRIVER_SOFT_LIMITS_ALTITUDE_B_FWD_INCREASES
            int "Second altitude motor: FORWARD increases encoder count (1) or not (0)"
            depends on DRIVER_ALTITUDE_B_ENABLE
            range 0 1
            default 1
            help
                PLACEHOLDER until bench tested. The second altitude motor
                uses the gearing and travel set above for altitude.
    endmenu
endmenu
```
