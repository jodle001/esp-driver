## main/Kconfig.projbuild
```kconfig
menu "Talos ESP Driver Configuration"

    comment "Pins follow the rev 0.3 controller board (project_documentation/hardware); expander bit map still rev 0.2"

    menu "Link to the Pi"
        choice SC_LINK_MODE
            prompt "Protocol on the link"
            default SC_LINK_MODE_ACL
            help
                Decided Oct 16 2026: the Pi runs the operator unchanged, so the link speaks
                the Eshed box's serial dialect (the ACL subset, scorbot_core/acl.h) at
                9600 8N1 over the DevKit's USB. The protobuf/COBS link of the ROS 2 stack
                remains as a second mode at 921600. "Auto" starts in the dialect at 9600 and
                switches to protobuf at 921600 when the first bytes are not text (a 0x00
                frame delimiter, or framing errors from a 921600 stream read at 9600).
            config SC_LINK_MODE_ACL
                bool "Eshed dialect (ACL text, 9600): the operator"
            config SC_LINK_MODE_PROTOBUF
                bool "protobuf/COBS (921600): the ROS 2 hardware interface"
            config SC_LINK_MODE_AUTO
                bool "auto: decide from the first bytes (untested on a device)"
        endchoice
        config SC_LINK_UART_NUM
            int "Link UART number"
            range 0 2
            default 0
            help
                0 = the DevKit's USB (CP2102), the rev 0.3 board's Pi link and flashing
                port; the console is off (sdkconfig.defaults). IO5/IO13 (UART1) carry the
                slide encoder since Oct 16 2026, so there is no other UART to spare.
        config SC_LINK_TX_GPIO
            int "Link UART TX GPIO (-1 = the UART's default pin)"
            range -1 33
            default -1
        config SC_LINK_RX_GPIO
            int "Link UART RX GPIO (-1 = the UART's default pin)"
            range -1 39
            default -1
        config SC_LINK_ACL_BAUD
            int "Baud rate in the Eshed dialect"
            default 9600
            help
                What the operator opens the port at (reference_only/operator erv.cpp: B9600).
        config SC_LINK_PROTOBUF_BAUD
            int "Baud rate for protobuf"
            default 921600
        config SC_ACL_SIGN_MASK
            hex "Eshed dialect: axes whose virtual counts run against the calibrated positive (bit per joint)"
            default 0x0
            help
                The dialect reports and takes virtual ER-V counts (the operator's degree
                factors are the ER-V's). Bit i set flips the sign for joint i, so the Pi
                sees the same direction on this robot as on the ER-V. The scale comes from
                the ER-V factors in scorbot_core/acl.c; the robot's own counts per radian
                are the NVS calibration.
        config SC_WATCHDOG_MS
            int "Default command watchdog (ms)"
            default 200
    endmenu

    config SC_JOINT_COUNT
        int "Joints driven (5 = the arm, 6 = plus the slide channel)"
        range 5 6
        default 5
        help
            The rev 0.3 board carries a sixth channel for the ER-4pc's slide base (driver
            socket U10, terminal J8, second expander U11 at 0x21, CS6 on the second ADC,
            encoder on IO5/IO13, PWM on IO2). The core and the Eshed dialect (axis 7)
            handle six joints; the device glue for the sixth (motor, limit_switch and
            current components, the second expander) is the rev 0.3 follow-through and
            is not written yet, so 6 does not build (see main/esp_driver.c).

    menu "Motor PWM (LEDC)"
        config SC_PWM_FREQ_HZ
            int "PWM frequency (Hz)"
            default 20000
        config SC_PWM1_GPIO
            int "PWM 1 GPIO"
            default 16
        config SC_PWM2_GPIO
            int "PWM 2 GPIO"
            default 17
        config SC_PWM3_GPIO
            int "PWM 3 GPIO"
            default 4
        config SC_PWM4_GPIO
            int "PWM 4 GPIO"
            default 18
        config SC_PWM5_GPIO
            int "PWM 5 GPIO"
            default 19
        config SC_PWM6_GPIO
            int "PWM 6 GPIO (the slide; rev 0.3: IO2, the DevKit's LED pin)"
            depends on SC_JOINT_COUNT = 6
            default 2
        config SC_SLP_GPIO
            int "Driver SLP (sleep) GPIO"
            default 15
            help
                The shared !SLP line of all five G2 drivers, held low through reset by the
                board's 2.2 k pull-down (R36). GPIO15 is a strapping pin: low at boot only
                silences the ROM's boot log on UART0, which the protocol link wants anyway.
        config SC_TOTAL_CURRENT_LIMIT_DA
            int "Summed motor current cap (0.1 A units, 0 = off)"
            default 80
            help
                While the sum of the measured motor currents is over this, an integral
                limiter winds every joint's velocity demand down together, and back up once
                the sum is under it again. It protects the 10 A fuse and the rail copper,
                which see the sum. Keep it above the largest single current_limit_a plus the
                running current of the other axes, or the homing hard-stop detector of a
                joint may never see its threshold.
    endmenu

    menu "Encoders (PCNT)"
        config SC_ENC_GLITCH_NS
            int "Glitch filter (ns)"
            default 1000
        config SC_ENC1_P0_GPIO
            int "Encoder 1 P0"
            default 36
        config SC_ENC1_P1_GPIO
            int "Encoder 1 P1"
            default 39
        config SC_ENC2_P0_GPIO
            int "Encoder 2 P0"
            default 34
        config SC_ENC2_P1_GPIO
            int "Encoder 2 P1"
            default 35
        config SC_ENC3_P0_GPIO
            int "Encoder 3 P0"
            default 32
        config SC_ENC3_P1_GPIO
            int "Encoder 3 P1"
            default 33
        config SC_ENC4_P0_GPIO
            int "Encoder 4 P0"
            default 25
        config SC_ENC4_P1_GPIO
            int "Encoder 4 P1"
            default 26
        config SC_ENC5_P0_GPIO
            int "Encoder 5 P0"
            default 27
        config SC_ENC5_P1_GPIO
            int "Encoder 5 P1"
            default 14
        config SC_ENC6_P0_GPIO
            int "Encoder 6 P0 (the slide; rev 0.3: IO5)"
            depends on SC_JOINT_COUNT = 6
            default 5
        config SC_ENC6_P1_GPIO
            int "Encoder 6 P1 (the slide; rev 0.3: IO13)"
            depends on SC_JOINT_COUNT = 6
            default 13
    endmenu

    menu "I2C: expander and ADCs"
        config SC_I2C_SDA_GPIO
            int "SDA GPIO"
            default 21
        config SC_I2C_SCL_GPIO
            int "SCL GPIO"
            default 22
        config SC_I2C_SPEED_HZ
            int "I2C speed (Hz)"
            default 400000
            help
                The board is laid out for 1 MHz; start at 400 kHz and raise it once the bus
                is proven.
        config SC_EXPANDER_ADDRESS
            hex "MCP23017 address"
            default 0x20
        config SC_EXPANDER_INT_GPIO
            int "MCP23017 INTA GPIO"
            default 23
        config SC_EXPANDER2_ADDRESS
            hex "Second MCP23017 address (the slide channel: DIR6, FLT6, SW6)"
            depends on SC_JOINT_COUNT = 6
            default 0x21
        config SC_SWITCH_ACTIVE_LOW
            bool "Limit switch pressed reads low"
            default y
        config SC_ADC_A_ADDRESS
            hex "ADS1015 A address (CS1-4)"
            default 0x48
        config SC_ADC_B_ADDRESS
            hex "ADS1015 B address (CS5, VSENSE)"
            default 0x49
        config SC_CS_MV_PER_A
            int "Driver current sense (mV per A)"
            default 20
        config SC_CS_OFFSET_MV
            int "Driver current sense offset at 0 A (mV)"
            default 50
        config SC_CS_MIN_DUTY_PCT
            int "Current sense: smallest duty used in the duty correction (%)"
            default 5
            help
                The G2's CS pin is active only while the H-bridge drives and is low during
                the PWM off-time, and the ADS1015 averages over its conversion, so the ADC
                reads duty x (20 mV/A x I + offset). The firmware divides by the commanded
                duty. Below this duty it divides by this value instead, so a small motor
                current is under-read rather than amplified from ADC noise.
        config SC_VSENSE_RATIO_X100
            int "Motor rail divider ratio x100 (39k/10k = 490)"
            default 490
        config SC_RAIL_OK_DV
            int "Motor rail present above (0.1 V units)"
            default 90
    endmenu

endmenu
```
